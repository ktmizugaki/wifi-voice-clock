## prog/components/simple_wifi/Kconfig
```kconfig
menu "Simple WiFi"
config SWIFI_MAX_AP_CONFS
    int "AP conf count"
    default 3
    help
        Number of access points that can be added.

config SWIFI_SOFTAP_IP
    string "SoftAP IP"
    default "192.168.4.1"
    help
        IP address of ESP32 when acting as Soft AP.
        Net mask is always 255.255.255.0.

config SWIFI_IFNAME_PREFIX
    string "SSID/hostname prefix (maximum 16 chars)"
    default "esp32"
    help
        Used for SSID prefix of ESP32 when acting as Soft AP.
        Used for hostname prefix when sending DHCP request.
        MAC address is added to prefix.
        Maximum 16 bytes.
endmenu
```

## prog/components/vcc/Kconfig
```kconfig
menu "Vcc "
config VCC_ADC2_CHANNEL
    int "ADC2 channel"
    default 0
    help
        Channel to read vcc.
        ADC2 channel 0 is GPIO4
        ADC2 channel 1 is GPIO0
        ADC2 channel 2 is GPIO2
        ADC2 channel 3 is GPIO15
        ADC2 channel 4 is GPIO13
        ADC2 channel 5 is GPIO12
        ADC2 channel 6 is GPIO14
        ADC2 channel 7 is GPIO27
        ADC2 channel 8 is GPIO25
        ADC2 channel 9 is GPIO26

config VCC_PIN
    int "VCC pin"
    default 5
    help
        Pin to output/enable vcc.

config VCC_HISIDE_R
    int "High side resister value"
    default 10
    help
        Resister value between ADC pin and Vcc.

config VCC_LOWSIDE_R
    int "Low side resister value"
    default 10
    help
        Resister value between ADC pin and GND.

config VCC_MAX
    int "Maximum Vcc voltage"
    default 3300
    help
        Maximum Vcc voltage in mV.

config VCC_DEFAULT_VREF
    int "Default Vref"
    default 1100
    help
        Vref value.

config VCC_CHARGE_STAT_PIN
    int "Charge stat pin"
    default -1
    help
        Pin to read stat.
endmenu
```

## prog/main/Kconfig.projbuild
```kconfig
menu "WiFi Voice Clock"

config NVS_ENCRYPTION
    bool "Enable NVS encryption"
    default y

config USE_SYSLOG
    bool "Use syslog over udp for some logging"
    default n

config SYSLOG_IP
    depends on USE_SYSLOG
    string "IP address of syslog server"

endmenu
```

## prog/sdkconfig.defaults
```kconfig
# flash size
CONFIG_ESPTOOLPY_FLASHSIZE_4MB=y
CONFIG_ESPTOOLPY_FLASHSIZE="4MB"
# partition
CONFIG_PARTITION_TABLE_SINGLE_APP=
CONFIG_PARTITION_TABLE_TWO_OTA=
CONFIG_PARTITION_TABLE_CUSTOM=y
CONFIG_PARTITION_TABLE_CUSTOM_FILENAME="partitions.csv"
CONFIG_PARTITION_TABLE_FILENAME="partitions.csv"
# FreeRTOS
CONFIG_FREERTOS_UNICORE=y
# bluetooth
CONFIG_BT_ENABLED=n
# RTC clock source
# NOTE: these config values are used by both of app and bootloader.
CONFIG_ESP32_RTC_CLK_SRC_EXT_CRYS=y
CONFIG_ESP32_RTC_CLK_CAL_CYCLES=3000
CONFIG_ESP32_RTC_XTAL_BOOTSTRAP_CYCLES=5
# vcc module
CONFIG_VCC_ADC2_CHANNEL=3
CONFIG_VCC_PIN=16
CONFIG_VCC_DEFAULT_VREF=1100
CONFIG_VCC_CHARGE_STAT_PIN=17
# Simple WiFi
CONFIG_SWIFI_SOFTAP_SSID_PREFIX="VoiceClock"
```
